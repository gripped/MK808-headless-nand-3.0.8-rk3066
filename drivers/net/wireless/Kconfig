## drivers/net/wireless/Kconfig
```kconfig
#
# Wireless LAN device configuration
#

menuconfig WLAN
	bool "Wireless LAN"
	depends on !S390
	depends on NET
	select WIRELESS
	default y
	---help---
	  This section contains all the pre 802.11 and 802.11 wireless
	  device drivers. For a complete list of drivers and documentation
	  on them refer to the wireless wiki:

	  http://wireless.kernel.org/en/users/Drivers

if WLAN

config WLAN_80211
	bool "Wireless LAN (IEEE 802.11)"
	depends on NETDEVICES
	---help---
	  Say Y if you have any 802.11 wireless LAN hardware.

	  This option does not affect the kernel build, it only
	  lets you choose drivers.


	config BCM4329
	  depends on WLAN_80211 && MMC
	  select WIRELESS_EXT
	  select WEXT_PRIV
	  select IEEE80211
	  select FW_LOADER
	  tristate "Broadcom BCM4329 WiFi/BT Combo SDIO"
	  ---help---
	    A library for Broadcom BCM4329 SDIO WLAN/BT combo devices.
	    So far, the following modules have been verified:
	      (1) Samsung    SWL-B23
	      
	config BCM4319
	  depends on WLAN_80211 && MMC
	  select WIRELESS_EXT
	  select WEXT_PRIV
	  select IEEE80211
	  select FW_LOADER
	  tristate "Broadcom BCM4319 WiFi SDIO"
	  ---help---
	    A library for Broadcom BCM4319 SDIO WLAN devices. 

source "drivers/net/wireless/rkwifi/Kconfig"
source "drivers/net/wireless/bcmdhd1/Kconfig"
source "drivers/net/wireless/bcm40181/Kconfig"
source "drivers/net/wireless/rt2x00/Kconfig"

choice	
	depends on RKWIFI && WLAN_80211
	prompt "Select the wifi module"
	default RK903
	
#	config BCM4329
#		bool "BCM4329"
#		depends on RKWIFI && WLAN_80211

	config BCM4330 
    	bool "BCM4330"
    	depends on RKWIFI && WLAN_80211

	config RK903
    	bool "RK903"
	    depends on RKWIFI && WLAN_80211

	config RK901
    	bool "RK901"
	    depends on RKWIFI && WLAN_80211

endchoice

choice	
	depends on RKWIFI && WLAN_80211
	prompt "Select the wifi module crystal freq"
	default RKWIFI_37_4M

	config RKWIFI_37_4M
    	bool "37_4M"
	    depends on RKWIFI && WLAN_80211

	config RKWIFI_26M
    	bool "26M"
	    depends on RKWIFI && WLAN_80211

endchoice

endif
```
